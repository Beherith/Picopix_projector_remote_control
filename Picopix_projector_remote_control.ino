#define ir_led_pin 3
#define PIN3ON PORTD|=0x08;
#define PIN3OFF PORTD&=0x08;

//example code from irdb globalcache :
//"BRIGHTNESS DOWN","sendir,1:1,1,38000,1,69,342,171,21,21,22,21,22,21,22,21,21,21,22,21,22,21,21,21,22,63,22,63,22,63,22,63,22,63,22,63,22,63,22,63,22,21,22,21,21,21,22,63,22,21,22,21,22,21,21,21,22,63,22,63,22,63,22,21,22,63,22,63,22,63,22,63,22,1527,341,85,22,1527",
//sendir,<connectoraddress>,<ID>,<frequency>,<repeat>,<offset>,<on1>,<off1>,<on2>,<off2>,….,<onN>,<offN> (where N is less than 260 or a total of 520 

const int BRIGHTNESS_DOWN[] PROGMEM ={342,171,21,21,22,21,22,21,22,21,21,21,22,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22,1527};
const int BRIGHTNESS_UP[] PROGMEM={343,171,21,21,22,21,22,21,21,22,21,21,22,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22,1529};
const int CURSOR_DOWN[] PROGMEM={343,171,22,21,21,21,22,21,22,21,21,21,22,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22,1527};
const int CURSOR_ENTER[] PROGMEM={343,171,21,21,22,21,22,21,21,21,22,21,22,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22,1530};
const int CURSOR_LEFT[] PROGMEM={342,171,21,21,22,21,22,21,22,21,21,21,22,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22,1527};
const int CURSOR_RIGHT[] PROGMEM={343,171,21,21,22,21,22,21,21,21,22,21,22,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22,1530};
const int CURSOR_UP[] PROGMEM={343,171,22,21,21,21,22,21,22,21,21,21,22,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21,1527};
const int FORWARD[] PROGMEM={342,171,22,21,21,22,21,21,22,21,22,21,21,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21,1527};
const int MUTE_TOGGLE[] PROGMEM={343,171,21,21,22,21,22,21,21,21,22,21,22,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21,3653};
const int PLAY_PAUSE_TOGGLE[] PROGMEM={342,171,22,21,22,21,21,22,21,21,22,21,22,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22,1530};
const int RETURN[] PROGMEM ={342,171,22,21,22,21,22,21,21,21,22,21,22,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22,1530};
const int REVERSE[] PROGMEM={342,171,22,21,22,21,21,21,22,21,22,21,21,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21,1527};
const int VOLUME_DOWN[] PROGMEM={343,171,21,22,21,21,22,21,22,21,21,21,22,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21,3654};
const int VOLUME_UP[] PROGMEM={342,171,22,21,22,21,21,21,22,21,22,21,21,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21,3657};
const int ZOOM[] PROGMEM ={341,171,22,21,22,21,21,21,22,21,22,21,22,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22,1527};

void pulse38khz(int count){
    for (int i = 0; i < count; i++){
      PORTD|=0x08; //this sets on bit 3
      delayMicroseconds(13);
      //Serial.println(digitalRead(ir_led_pin));
      PORTD&=0b11110111; // clears only 3
      delayMicroseconds(13);
      //Serial.println(digitalRead(ir_led_pin));
    }
  }

void sendcode(const int * code, int l){
  //Serial.println(l);
  for (int i = 0; i < l; i++){
      int d = pgm_read_word(&code[i]);
      //Serial.print(i);
      //Serial.print(' ');
      //Serial.println(d); //COMMENT THIS OUT!
      if (i&1) { //odd codes are off, even codes are on
        delayMicroseconds(26*d);
      }else{
        pulse38khz(d);
      }
    }
  delay(500);
  }
void setup() {
  // put your setup code here, to run once:
  pinMode(ir_led_pin,OUTPUT);
  digitalWrite(ir_led_pin,LOW);
  pulse38khz(32000); //just for testing
  Serial.begin(115200);
  Serial.print("reddy ");
  Serial.println(sizeof(BRIGHTNESS_DOWN));
}

void loop() {
  // put your main code here, to run repeatedly:
  sendcode(BRIGHTNESS_DOWN, sizeof(BRIGHTNESS_DOWN));
  sendcode(BRIGHTNESS_UP, sizeof(BRIGHTNESS_UP));
  sendcode(CURSOR_DOWN ,sizeof(CURSOR_DOWN));
  sendcode(CURSOR_ENTER,sizeof(CURSOR_ENTER) );
  sendcode(CURSOR_LEFT, sizeof(CURSOR_LEFT) );
  sendcode(CURSOR_RIGHT, sizeof(CURSOR_RIGHT) );
  sendcode(CURSOR_UP ,sizeof(CURSOR_UP));
  sendcode(FORWARD ,sizeof(FORWARD));
  sendcode(MUTE_TOGGLE,sizeof(MUTE_TOGGLE) );
  sendcode(PLAY_PAUSE_TOGGLE, sizeof(PLAY_PAUSE_TOGGLE ));
  sendcode(RETURN,sizeof(RETURN ));
  sendcode(REVERSE,sizeof(REVERSE) );
  sendcode(VOLUME_DOWN,sizeof(VOLUME_DOWN) );
  sendcode(VOLUME_UP,sizeof(VOLUME_UP) );
  sendcode(ZOOM,sizeof(ZOOM) );
}
